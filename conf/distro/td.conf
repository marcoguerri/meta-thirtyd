## conf/distro/td.conf
```bitbake
INHERIT += "extrausers"

EXTRA_USERS_PARAMS = " \
    usermod -p '\$1\$PotiW661\$MCKupx8760Tqopn8dMTDx/' root; \
    useradd -p '\$1\$Nhj07r30\$lpZbyxQH4KFE2eXxbfj7V0' mguerri; \
    "



DISTRO_FEATURES_DEFAULT="argp ext2 largefile usbgadget usbhost xattr zeroconf pam"
```

## conf/distro/thirtyd.conf
```bitbake
INHERIT += "extrausers devshell"

# Default password ($1$5dLl9u4u$TXXJR4IKmByLHkLvWCQ210) is "letmein"

EXTRA_USERS_PARAMS = " \
    usermod -p '\$1\$5dLl9u4u\$TXXJR4IKmByLHkLvWCQ210' root; \
    useradd -p '\$1\$5dLl9u4u\$TXXJR4IKmByLHkLvWCQ210' guest; \
    "

DISTRO_NAME="thirtyd"
DISTRO_VERSION="0.1.alpha"
DISTRO_FEATURES_DEFAULT="pam systemd"
VIRTUAL-RUNTIME_init_manager="systemd"


##########################################
# Mender related configuration.
##########################################
INHERIT += "mender-full"

# The following entries should be migrated to machine specific 
# configuration
MENDER_STORAGE_TOTAL_SIZE_MB="8192"
# Data partition is extended at first boot to take up all unused
# space on the block device. Given we have an overall size of 9 GiB
# and 4 GiB are taken for data, the remaining 4 will be split between
# rootfs A/B and boot.
MENDER_DATA_PART_SIZE_MB="4096"
MENDER_STORAGE_DEVICE = "/dev/mmcblk0"

# We are interested in mender's uefiimg FSTYPE, which is added
# automatically by enabling mender-image-uefi. When inheriting
# from mender-full, UEFI image FSTYPE is enabled
IMAGE_FSTYPES_remove="wic wic.bmap wic.gz"

# meta-mender unconditionally adds 
# ${@d.getVarFlag('do_image_wic', 'depends', False)}
# to _MENDER_PART_IMAGE_DEPENDS, which becomes a tasklist
# for mender_uefiimg. So, remove that hidden dependency
do_image_wic[depends] = ""

MENDER_ARTIFACT_NAME="mender-meta"
```

## conf/layer.conf
```bitbake
BBPATH .= ":${LAYERDIR}"
BBFILES += "${LAYERDIR}/recipes-*/*/*.bb \
            ${LAYERDIR}/recipes-*/*.bb \
            ${LAYERDIR}/recipes-*/*/*.bbappend"

BBFILE_COLLECTIONS += "thirtyd"
BBFILE_PATTERN_thirtyd := "^${LAYERDIR}/"
BBFILE_PRIORITY_thirtyd = "4"
LAYERSERIES_COMPAT_thirtyd = "meta-openembedded meta-raspberrypi sumo dunfell"
```

## layer/conf/distro/thirtyd.conf
```bitbake
INHERIT += "extrausers devshell"

# Default password ($1$5dLl9u4u$TXXJR4IKmByLHkLvWCQ210) is "letmein"

EXTRA_USERS_PARAMS = " \
    usermod -p '\$1\$5dLl9u4u\$TXXJR4IKmByLHkLvWCQ210' root; \
    useradd -p '\$1\$5dLl9u4u\$TXXJR4IKmByLHkLvWCQ210' guest; \
    "

DISTRO_NAME="thirtyd"
DISTRO_FEATURES_DEFAULT="pam systemd"
VIRTUAL-RUNTIME_init_manager="systemd"
```
